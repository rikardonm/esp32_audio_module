## src/sinker/main/Kconfig.projbuild
```kconfig
menu "mybtt ESP32 Audio Module"

#    choice EXAMPLE_A2DP_SINK_OUTPUT
#        prompt "A2DP Sink Output"
#        default EXAMPLE_A2DP_SINK_OUTPUT_EXTERNAL_I2S
#        help
#            Select to use Internal DAC or external I2S driver
#
#        config EXAMPLE_A2DP_SINK_OUTPUT_INTERNAL_DAC
#            bool "Internal DAC"
#            help
#                Select this to use Internal DAC sink output
#
#        config EXAMPLE_A2DP_SINK_OUTPUT_EXTERNAL_I2S
#            bool "External I2S Codec"
#            help
#                Select this to use External I2S sink output
#
#    endchoice

   config MYBTT_ESP32_AUDIO_MODULE_I2S_BLK_PIN
	int "I2S BLK PIN"
	default 21
	help
	     IO number for BLK/BCK pin.

   config MYBTT_ESP32_AUDIO_MODULE_I2S_LCK_PIN
	int "I2S LCK PIN"
	default 18
	help
	     IO number for LCK pin.

    config MYBTT_ESP32_AUDIO_MODULE_I2S_DOUT_PIN
	int "I2S DOUT PIN"
	default 19
	help
	     IO number for DIN (codec) / DOUT (ESP32) pin.

endmenu
```
